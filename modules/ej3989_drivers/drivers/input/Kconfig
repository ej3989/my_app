## modules/ej3989_drivers/drivers/input/Kconfig
```kconfig
# SPDX-License-Identifier: Apache-2.0

config EJ3989_INPUT_XPT2046
	bool "Waveshare 3.5C XPT2046 touch panel driver"
	default y
	depends on DT_HAS_XPTEK_XPT2046_WAVESHARE_35C_ENABLED
	select SPI
	help
	  Enable the out-of-tree XPT2046 resistive touch driver used by the
	  Waveshare/MHS 3.5 inch Raspberry Pi style SPI LCD.
```

## modules/ej3989_drivers/drivers/sensor/Kconfig
```kconfig
# SPDX-License-Identifier: Apache-2.0

config EJ3989_SENSOR_AHT10
	bool "Aosong AHT10 temperature and humidity sensor"
	default y
	depends on SENSOR
	depends on DT_HAS_AOSONG_AHT10_ENABLED
	select I2C
	help
	  Enable the out-of-tree driver for the Aosong AHT10 I2C temperature
	  and humidity sensor.
```

## modules/ej3989_drivers/dts/bindings/sensor/aosong,aht10.yaml
```yaml
# SPDX-License-Identifier: Apache-2.0

description: |
  Aosong AHT10 digital-output humidity and temperature sensor.

compatible: "aosong,aht10"

include: [sensor-device.yaml, i2c-device.yaml]
```

## modules/waveshare_35c_drivers/Kconfig
```kconfig
# SPDX-License-Identifier: Apache-2.0

menu "Waveshare 3.5C out-of-tree drivers"

rsource "drivers/display/Kconfig"
rsource "drivers/input/Kconfig"

endmenu
```

## modules/waveshare_35c_drivers/drivers/display/Kconfig
```kconfig
# SPDX-License-Identifier: Apache-2.0

config WAVESHARE_35C_ILI9XXX
	bool
	help
	  Shared ILI9XXX core used by the Waveshare 3.5C ILI9486 driver.

config WAVESHARE_35C_ILI9XXX_READ
	bool "Allow display_read API with Waveshare 3.5C ILI9XXX"
	depends on WAVESHARE_35C_ILI9XXX
	help
	  Optional read support for the out-of-tree ILI9XXX core.

config WAVESHARE_35C_ILI9486
	bool "Waveshare 3.5C ILI9486 display driver"
	default y
	depends on DT_HAS_ILITEK_ILI9486_ENABLED
	select MIPI_DBI
	select WAVESHARE_35C_ILI9XXX
	help
	  Enable the out-of-tree ILI9486 driver used by the Waveshare/MHS
	  3.5 inch Raspberry Pi style SPI LCD.
```
