## CMakeLists.txt
```
# SPDX-License-Identifier: Apache-2.0

cmake_minimum_required(VERSION 3.20.0)

find_package(Zephyr REQUIRED HINTS $ENV{ZEPHYR_BASE})
project(zephyr_kernel_practice)

target_sources(app PRIVATE src/main.c)

if(DEFINED PRACTICE_EXERCISE)
  target_compile_definitions(app PRIVATE PRACTICE_EXERCISE=${PRACTICE_EXERCISE})
endif()
```

## prj.conf
```kconfig
# Keep this app focused on kernel basics and serial console output.
CONFIG_GPIO=y
CONFIG_CONSOLE=y
CONFIG_UART_CONSOLE=y
CONFIG_PRINTK=y

CONFIG_MAIN_STACK_SIZE=4096
CONFIG_SYSTEM_WORKQUEUE_STACK_SIZE=2048
```

## boards/esp32s3_devkitc_procpu.conf
```kconfig
# ESP32-S3-WROOM-1-N16R8 uses 16 MB Quad SPI flash and 8 MB Octal SPI PSRAM.
# Match the local board setup used by the other EJ_APP examples.
CONFIG_SPIRAM_MODE_OCT=y
CONFIG_ESPTOOLPY_OCT_FLASH=n
```

## src/main.c
```c
/*
 * Zephyr kernel practice app.
 *
 * Set PRACTICE_EXERCISE in this file or pass -DPRACTICE_EXERCISE=N to CMake.
 */

#include <zephyr/kernel.h>
#include <zephyr/device.h>
#include <zephyr/drivers/gpio.h>
#include <zephyr/sys/atomic.h>
#include <zephyr/sys/printk.h>

#ifndef PRACTICE_EXERCISE
#define PRACTICE_EXERCISE 8
#endif

#define STACK_SIZE 1024
#define THREAD_PRIORITY 5

struct sample_msg {
	int producer_id;
	int value;
};

enum app_event_type {
	APP_EVENT_BUTTON_PRESSED = 1,
};

struct app_event {
	enum app_event_type type;
	int value;
	int64_t uptime_ms;
};

struct app_state {
	int button_count;
	int64_t last_pressed_ms;
};
struct ej_app_state{
	int button_count;
	int64_t last_pressed_ms;
};

enum ej_event_type {
	EJ_APP_EVENT_BUTTON_PRESSED = 1,
};

struct ej_event {
	enum ej_event_type type;
	int value;
	int64_t uptime_ms;
};

K_MSGQ_DEFINE(sample_msgq, sizeof(struct sample_msg), 8, 4);
K_MSGQ_DEFINE(app_event_msgq, sizeof(struct app_event), 8, 4);
K_SEM_DEFINE(signal_sem, 0, 1);
K_MUTEX_DEFINE(shared_counter_mutex);
K_MUTEX_DEFINE(app_state_mutex);

K_THREAD_STACK_DEFINE(thread_a_stack, STACK_SIZE);
K_THREAD_STACK_DEFINE(thread_b_stack, STACK_SIZE);

static struct k_thread thread_a;
static struct k_thread thread_b;

static struct k_work immediate_work;
static struct k_work_delayable delayable_work;
static struct k_work timer_work;
static struct k_timer practice_timer;
static struct k_work_delayable button_debounce_work;
static struct k_work status_work;
static struct k_timer status_timer;

static struct k_work_delayable ej_delay_work;
static struct k_work ej_kwork;
static struct k_timer ej_timer;
static struct ej_app_state ej_state;
static struct gpio_callback ej_button_cb;
static struct k_thread ej_thread_a;

K_THREAD_STACK_DEFINE(ej_thread_a_stack, STACK_SIZE);
K_MUTEX_DEFINE(ej_app_state_mutex);
K_MSGQ_DEFINE(ej_event_msgq, sizeof(struct ej_event), 8, 4);

static atomic_t fake_irq_count;
static atomic_t delayable_count;
static atomic_t timer_count;
static int shared_counter;
static struct app_state state;
static const struct gpio_dt_spec button = GPIO_DT_SPEC_GET(DT_ALIAS(sw0), gpios);
static struct gpio_callback button_cb;

static void thread_counter(void *name_ptr, void *start_ptr, void *unused)
{
	const char *name = name_ptr;
	int value = POINTER_TO_INT(start_ptr);

	ARG_UNUSED(unused);

	for (int i = 0; i < 5; i++) {
		printk("[%s] value=%d\n", name, value++);
		k_sleep(K_MSEC(300));
	}

	printk("[%s] done\n", name);
}

static void run_thread_demo(void)
{
	printk("exercise 1: two threads run independently\n");

	k_thread_create(&thread_a, thread_a_stack, STACK_SIZE,
			thread_counter, "thread A", INT_TO_POINTER(10), NULL,
			THREAD_PRIORITY, 0, K_NO_WAIT);

	k_thread_create(&thread_b, thread_b_stack, STACK_SIZE,
			thread_counter, "thread B", INT_TO_POINTER(100), NULL,
			THREAD_PRIORITY, 0, K_NO_WAIT);

	for (int i = 0; i < 6; i++) {
		printk("[main] still alive %d\n", i);
		k_sleep(K_MSEC(500));
	}
}

static void sem_waiter(void *unused_a, void *unused_b, void *unused_c)
{
	ARG_UNUSED(unused_a);
	ARG_UNUSED(unused_b);
	ARG_UNUSED(unused_c);

	for (int i = 0; i < 5; i++) {
		printk("[waiter] waiting for semaphore\n");
		k_sem_take(&signal_sem, K_FOREVER);
		printk("[waiter] got signal %d\n", i);
	}
}

static void run_semaphore_demo(void)
{
	printk("exercise 2: main thread signals a worker with k_sem_give()\n");

	k_thread_create(&thread_a, thread_a_stack, STACK_SIZE,
			sem_waiter, NULL, NULL, NULL,
			THREAD_PRIORITY, 0, K_NO_WAIT);

	for (int i = 0; i < 5; i++) {
		k_sleep(K_MSEC(700));
		printk("[main] give semaphore %d\n", i);
		k_sem_give(&signal_sem);
	}
}

static void msgq_producer(void *unused_a, void *unused_b, void *unused_c)
{
	ARG_UNUSED(unused_a);
	ARG_UNUSED(unused_b);
	ARG_UNUSED(unused_c);

	for (int i = 0; i < 8; i++) {
		struct sample_msg msg = {
			.producer_id = 1,
			.value = i * 10,
		};

		k_msgq_put(&sample_msgq, &msg, K_FOREVER);
		printk("[producer] put value=%d\n", msg.value);
		k_sleep(K_MSEC(250));
	}
}

static void msgq_consumer(void *unused_a, void *unused_b, void *unused_c)
{
	ARG_UNUSED(unused_a);
	ARG_UNUSED(unused_b);
	ARG_UNUSED(unused_c);

	for (int i = 0; i < 8; i++) {
		struct sample_msg msg;

		k_msgq_get(&sample_msgq, &msg, K_FOREVER);
		printk("[consumer] producer=%d value=%d\n", msg.producer_id, msg.value);
	}
}

static void run_msgq_demo(void)
{
	printk("exercise 3: producer and consumer communicate through k_msgq\n");

	k_thread_create(&thread_a, thread_a_stack, STACK_SIZE,
			msgq_producer, NULL, NULL, NULL,
			THREAD_PRIORITY, 0, K_NO_WAIT);

	k_thread_create(&thread_b, thread_b_stack, STACK_SIZE,
			msgq_consumer, NULL, NULL, NULL,
			THREAD_PRIORITY, 0, K_NO_WAIT);

	k_sleep(K_SECONDS(4));
}

static void immediate_work_handler(struct k_work *work)
{
	int count = atomic_get(&fake_irq_count);

	ARG_UNUSED(work);

	printk("[work] handling fake IRQ count=%d in workqueue thread\n", count);
}

static void fake_gpio_isr_event(void)
{
	atomic_inc(&fake_irq_count);
	printk("[fake ISR] submit immediate work\n");
	k_work_submit(&immediate_work);
}

static void run_immediate_work_demo(void)
{
	printk("exercise 4: simulated ISR offloads processing with k_work_submit()\n");

	k_work_init(&immediate_work, immediate_work_handler);

	for (int i = 0; i < 5; i++) {
		fake_gpio_isr_event();
		k_sleep(K_MSEC(500));
	}
}

static void delayable_work_handler(struct k_work *work)
{
	int count = atomic_inc(&delayable_count) + 1;
	struct k_work_delayable *dwork = k_work_delayable_from_work(work);

	printk("[delayable] fired count=%d\n", count);

	if (count < 5) {
		printk("[delayable] reschedule itself after 300 ms\n");
		k_work_reschedule(dwork, K_MSEC(300));
	}
}

static void run_delayable_work_demo(void)
{
	printk("exercise 5: delayable work reschedules itself\n");

	atomic_set(&delayable_count, 0);
	k_work_init_delayable(&delayable_work, delayable_work_handler);
	k_work_reschedule(&delayable_work, K_MSEC(300));

	k_sleep(K_SECONDS(3));
}

static void timer_work_handler(struct k_work *work)
{
	int count = atomic_get(&timer_count);

	ARG_UNUSED(work);

	printk("[timer work] safe thread-context processing, timer_count=%d\n", count);
}

static void timer_expiry_handler(struct k_timer *timer)
{
	int count = atomic_inc(&timer_count) + 1;

	ARG_UNUSED(timer);

	printk("[timer expiry] count=%d, offload to workqueue\n", count);
	k_work_submit(&timer_work);
}

static void run_timer_demo(void)
{
	printk("exercise 6: timer expiry callback offloads real work\n");

	atomic_set(&timer_count, 0);
	k_work_init(&timer_work, timer_work_handler);
	k_timer_init(&practice_timer, timer_expiry_handler, NULL);
	k_timer_start(&practice_timer, K_MSEC(500), K_MSEC(500));

	k_sleep(K_SECONDS(4));
	k_timer_stop(&practice_timer);
	printk("[main] timer stopped\n");
}

static void mutex_counter_thread(void *name_ptr, void *use_mutex_ptr, void *unused)
{
	const char *name = name_ptr;
	bool use_mutex = POINTER_TO_INT(use_mutex_ptr);

	ARG_UNUSED(unused);

	for (int i = 0; i < 5; i++) {
		if (use_mutex) {
			k_mutex_lock(&shared_counter_mutex, K_FOREVER);
		}

		int before = shared_counter;

		printk("[%s] read shared_counter=%d\n", name, before);
		k_sleep(K_MSEC(100));
		shared_counter = before + 1;
		printk("[%s] wrote shared_counter=%d\n", name, shared_counter);

		if (use_mutex) {
			k_mutex_unlock(&shared_counter_mutex);
		}

		k_sleep(K_MSEC(100));
	}
}

static void run_mutex_demo(void)
{
	bool use_mutex = true;

	printk("exercise 7: protect shared_counter with k_mutex\n");
	printk("[main] use_mutex=%d\n", use_mutex);

	shared_counter = 0;

	k_thread_create(&thread_a, thread_a_stack, STACK_SIZE,
			mutex_counter_thread, "thread A", INT_TO_POINTER(use_mutex), NULL,
			THREAD_PRIORITY, 0, K_NO_WAIT);

	k_thread_create(&thread_b, thread_b_stack, STACK_SIZE,
			mutex_counter_thread, "thread B", INT_TO_POINTER(use_mutex), NULL,
			THREAD_PRIORITY, 0, K_NO_WAIT);

	k_sleep(K_SECONDS(3));
	printk("[main] final shared_counter=%d\n", shared_counter);
}

static void button_isr(const struct device *dev, struct gpio_callback *cb, uint32_t pins)
{
	ARG_UNUSED(dev);
	ARG_UNUSED(cb);
	ARG_UNUSED(pins);

	k_work_reschedule(&button_debounce_work, K_MSEC(30));
}

static void button_debounce_handler(struct k_work *work)
{
	struct app_event event = {
		.type = APP_EVENT_BUTTON_PRESSED,
		.value = 1,
		.uptime_ms = k_uptime_get(),
	};

	ARG_UNUSED(work);

	if (gpio_pin_get_dt(&button) > 0) {
		k_msgq_put(&app_event_msgq, &event, K_NO_WAIT);
	}
}

static void app_event_thread(void *unused_a, void *unused_b, void *unused_c)
{
	ARG_UNUSED(unused_a);
	ARG_UNUSED(unused_b);
	ARG_UNUSED(unused_c);

	while (1) {
		struct app_event event;

		k_msgq_get(&app_event_msgq, &event, K_FOREVER);

		if (event.type == APP_EVENT_BUTTON_PRESSED) {
			int button_count;

			k_mutex_lock(&app_state_mutex, K_FOREVER);
			state.button_count += event.value;
			state.last_pressed_ms = event.uptime_ms;
			button_count = state.button_count;
			k_mutex_unlock(&app_state_mutex);

			printk("[app] button event, count=%d\n", button_count);
		}
	}
}


static void status_work_handler(struct k_work *work)
{
	int button_count;
	int64_t last_pressed_ms;

	ARG_UNUSED(work);

	k_mutex_lock(&app_state_mutex, K_FOREVER);
	button_count = state.button_count;
	last_pressed_ms = state.last_pressed_ms;
	k_mutex_unlock(&app_state_mutex);

	printk("[status] button_count=%d last_pressed_ms=%lld\n",
	       button_count, last_pressed_ms);
}

static void status_timer_handler(struct k_timer *timer)
{
	ARG_UNUSED(timer);

	k_work_submit(&status_work);
}

static void run_button_event_app_demo(void)
{
	int ret;

	printk("exercise 8: GPIO ISR, debounce work, msgq, app thread, timer\n");

	if (!gpio_is_ready_dt(&button)) {
		printk("[button] device is not ready\n");
		return;
	}

	k_work_init_delayable(&button_debounce_work, button_debounce_handler);
	k_work_init(&status_work, status_work_handler);
	k_timer_init(&status_timer, status_timer_handler, NULL);

	state.button_count = 0;
	state.last_pressed_ms = 0;

	ret = gpio_pin_configure_dt(&button, GPIO_INPUT);
	if (ret != 0) {
		printk("[button] configure failed: %d\n", ret);
		return;
	}

	gpio_init_callback(&button_cb, button_isr, BIT(button.pin));
	ret = gpio_add_callback(button.port, &button_cb);
	if (ret != 0) {
		printk("[button] add callback failed: %d\n", ret);
		return;
	}

	ret = gpio_pin_interrupt_configure_dt(&button, GPIO_INT_EDGE_TO_ACTIVE);
	if (ret != 0) {
		printk("[button] interrupt configure failed: %d\n", ret);
		return;
	}

	k_thread_create(&thread_a, thread_a_stack, STACK_SIZE,
			app_event_thread, NULL, NULL, NULL,
			THREAD_PRIORITY, 0, K_NO_WAIT);

	k_timer_start(&status_timer, K_SECONDS(1), K_SECONDS(1));
	k_sleep(K_SECONDS(20));
	k_timer_stop(&status_timer);
	printk("[main] exercise 8 stopped\n");
}

static void ej_delayable_handler(struct k_work *works)
{
	struct ej_event event = {
		.type = EJ_APP_EVENT_BUTTON_PRESSED,
		.value = 1,
		.uptime_ms = k_uptime_get(),
	};

	ARG_UNUSED(works);

	if(gpio_pin_get_dt(&button) > 0){

		k_msgq_put(&ej_event_msgq,&event,K_NO_WAIT);
	}

	return;
} 
static void ej_kwork_handler(struct k_work *works)
{
	int button_count = 0;
	int64_t button_second = 0;
	ARG_UNUSED(works);

	k_mutex_lock(&ej_app_state_mutex,K_FOREVER);
	button_count = ej_state.button_count;
	button_second = ej_state.last_pressed_ms;
	k_mutex_unlock(&ej_app_state_mutex);

	printk("[State] Button state: count %d Button release time %lld\n", 
		button_count, button_second);
	return;
}

static void ej_timer_handler(struct k_timer *timers)
{
	ARG_UNUSED(timers);
	
	k_work_submit(&ej_kwork);
	return;
}
static void ej_button_isr(const struct device *dev, struct gpio_callback *cb, gpio_port_pins_t pins)
{
	ARG_UNUSED(dev);
	ARG_UNUSED(cb);
	ARG_UNUSED(pins);

	k_work_reschedule(&ej_delay_work,K_MSEC(20));

	return;
}

static void ej_thread_handler(void *unused_a, void *unused_b, void *unused_c)
{


	ARG_UNUSED(unused_a);
	ARG_UNUSED(unused_b);
	ARG_UNUSED(unused_c);

	while(1){

		struct ej_event event;
		k_msgq_get(&ej_event_msgq,&event,K_FOREVER);
		if(event.type == APP_EVENT_BUTTON_PRESSED){
			int button_count;

			k_mutex_lock(&ej_app_state_mutex,K_FOREVER);
			ej_state.button_count += event.value;
			ej_state.last_pressed_ms = event.uptime_ms;
			button_count = ej_state.button_count;
			k_mutex_unlock(&ej_app_state_mutex);

			printk("[App] button event count: %d\n",button_count);


		}
	}

	return;
}
static void run_button_event_app_manual_demo(void)
{
	int ret;
	printk("exercixe 8: manual \n");
	if(!gpio_is_ready_dt(&button)){
		printk("[button] device is not ready\n");
		return;
	}
	k_work_init_delayable(&ej_delay_work,ej_delayable_handler);
	k_work_init(&ej_kwork,ej_kwork_handler);
	k_timer_init(&ej_timer,ej_timer_handler,NULL);

	state.button_count = 0;
	state.last_pressed_ms = 0;

	ret = gpio_pin_configure_dt(&button, GPIO_INPUT);
	if(ret != 0){
		printk("[Button] Configure fail:%d \n",ret);
		return;
	}

	gpio_init_callback(&ej_button_cb,ej_button_isr,BIT(button.pin));
	ret = gpio_add_callback(button.port, &ej_button_cb);
	if(ret != 0){
		printk("[Button] Add callback fail : %d\n",ret);
		return;
	}

	ret = gpio_pin_interrupt_configure_dt(&button, GPIO_INT_EDGE_TO_ACTIVE);
	if(ret != 0){
		printk("[Button] interrupt configure fail :%d\n",ret);
		return;
	}
	k_thread_create(&ej_thread_a, ej_thread_a_stack,STACK_SIZE,
					ej_thread_handler,NULL,NULL,NULL,
					THREAD_PRIORITY,0,K_NO_WAIT );

	k_timer_start(&ej_timer, K_SECONDS(1), K_SECONDS(1));
	k_sleep(K_SECONDS(20));
	k_timer_stop(&ej_timer);

	printk("[Main] exercise 8 end \n");
			
} 

int main(void)
{
	printk("\nZephyr kernel practice app started\n");
	printk("PRACTICE_EXERCISE=%d\n\n", PRACTICE_EXERCISE);

#if PRACTICE_EXERCISE == 1
	run_thread_demo();
#elif PRACTICE_EXERCISE == 2
	run_semaphore_demo();
#elif PRACTICE_EXERCISE == 3
	run_msgq_demo();
#elif PRACTICE_EXERCISE == 4
	run_immediate_work_demo();
#elif PRACTICE_EXERCISE == 5
	run_delayable_work_demo();
#elif PRACTICE_EXERCISE == 6
	run_timer_demo();
#elif PRACTICE_EXERCISE == 7
	run_mutex_demo();
#elif PRACTICE_EXERCISE == 8
	// run_button_event_app_demo();
	run_button_event_app_manual_demo();
#else
#error "Set PRACTICE_EXERCISE to a value from 1 to 8"
#endif

	printk("\nExercise finished. Change PRACTICE_EXERCISE and rebuild for the next one.\n");

	return 0;
}
```
